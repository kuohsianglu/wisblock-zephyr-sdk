/*
 * SPDX-License-Identifier: Apache-2.0
 */
&i2c0 {
	/* ST Microelectronics LIS3DH motion sensor */
	lis3dh: lis3dh@18 {
		compatible = "st,lis3dh", "st,lis2dh";
		reg = <0x18>;
		irq-gpios = <&gpio0 17 0>, <&gpio1 2 0>;
	};
};
